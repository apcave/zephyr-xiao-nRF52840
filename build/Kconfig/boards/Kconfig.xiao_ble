## build/Kconfig/boards/Kconfig.xiao_ble
```kconfig
# Load board Kconfig descriptions.
osource "/home/apcave/nordic/zephyr/boards/seeed/xiao_ble/Kconfig.xiao_ble"
```

## build/mcuboot/Kconfig/arch/Kconfig
```kconfig
# Load Zephyr Arch Kconfig descriptions.
osource "/home/apcave/nordic/zephyr/arch/x86/Kconfig"
osource "/home/apcave/nordic/zephyr/arch/xtensa/Kconfig"
osource "/home/apcave/nordic/zephyr/arch/sparc/Kconfig"
osource "/home/apcave/nordic/zephyr/arch/riscv/Kconfig"
osource "/home/apcave/nordic/zephyr/arch/posix/Kconfig"
osource "/home/apcave/nordic/zephyr/arch/nios2/Kconfig"
osource "/home/apcave/nordic/zephyr/arch/mips/Kconfig"
osource "/home/apcave/nordic/zephyr/arch/arm64/Kconfig"
osource "/home/apcave/nordic/zephyr/arch/arm/Kconfig"
osource "/home/apcave/nordic/zephyr/arch/arc/Kconfig"
```

## build/mcuboot/Kconfig/boards/Kconfig
```kconfig
# Load Zephyr board Kconfig descriptions.
osource "/home/apcave/nordic/zephyr/boards/seeed/xiao_ble/Kconfig"
```

## build/reset/Kconfig/boards/Kconfig.defconfig
```kconfig
# Load Zephyr board defconfig descriptions.
osource "/home/apcave/nordic/zephyr/boards/seeed/xiao_ble/Kconfig.defconfig"
```

## build/reset/Kconfig/boards/Kconfig.sysbuild
```kconfig
# Load Sysbuild board Kconfig descriptions.
osource "/home/apcave/nordic/zephyr/boards/seeed/xiao_ble/Kconfig.sysbuild"
```
